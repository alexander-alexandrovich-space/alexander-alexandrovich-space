#include <ArduinoBLE.h>
const float realDistances[] = {
  100.0, 101.0, 102.0, 103.0, 104.0, 105.0, 106.0, 107.0, 108.0, 109.0, 110.0, 111.0, 112.0, 113.0, 114.0, 115.0, 116.0, 117.0, 118.0, 119.0, 120.0, 121.0, 122.0, 123.0, 124.0, 125.0, 126.0, 127.0, 128.0, 129.0,
  130.0, 131.0, 132.0, 133.0, 134.0, 135.0, 136.0, 137.0, 138.0, 139.0,
  140.0, 141.0, 142.0, 143.0, 144.0, 145.0, 146.0, 147.0, 148.0, 149.0,
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  1961.0,1962.0,1963.0,1964.0,1965.0,1966.0,1967.0,1968.0,1969.0,1970.0,1971.0,1972.0,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2000.0,
};
const float measuredDistances[] = {
  158.0, 159.3, 160.6, 161.8, 163.1, 164.4, 165.7, 167.0, 168.2, 169.5,
  170.8, 172.1, 173.4, 174.6, 175.9, 177.2, 178.5, 179.8, 181.0, 182.3,
  183.6, 184.9, 186.2, 187.4, 188.7, 190.0, 191.3, 192.6, 193.8, 195.1,
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  1928.3, 1929.3, 1930.2, 1931.1, 1932.1, 1933.0, 1934.0, 1934.9, 1935.8, 1936.8, 1937.7, 1938.7, 1939.6, 1940.5, 1941.5, 1942.4, 1943.4, 1944.3, 1945.2, 1946.2, 1947.1, 1948.1, 1949.0
};
unsigned char TOF_header[3] = {0x57, 0x00, 0xFF}; 
unsigned char TOF_data[32] = {0}; 
unsigned char TOF_length = 16;
unsigned long TOF_distance = 0;
unsigned char TOF_signal = 0;

BLEService servo_service("19B10000-E8F2-537E-4F6C-D104768A1214"); // Bluetooth® Low Energy LED Service

// Bluetooth® Low Energy LED Switch Characteristic - custom 128-bit UUID, read and writable by central
BLEIntCharacteristic servoCharacteristic1("19B10001-E8F2-537E-4F6C-D104768A1201", BLERead | BLEWrite);
BLEIntCharacteristic servoCharacteristic2("19B10001-E8F2-537E-4F6C-D104768A1202", BLERead | BLEWrite);

//const int ledPin = LED_BUILTIN; // pin to use for the LED
int servo_pos1=-1;
int servo_pos2=-1;

//FILE *test = fopen("C:\\Users\Alexander\Desktop\test.txt", "w+");

void setup() {

  Serial.begin(921600); 
  Serial1.begin(921600);
  while (!Serial);
  if (!BLE.begin()) {
    //Serial.println("starting Bluetooth® Low Energy module failed!");
    while (1);
  }
  // set advertised local name and service UUID:
  BLE.setLocalName("nano 33 ble");
  BLE.setAdvertisedService(servo_service);

  // add the characteristic to the service
  servo_service.addCharacteristic(servoCharacteristic1);
  servo_service.addCharacteristic(servoCharacteristic2);

  // add service
  BLE.addService(servo_service);

  // set the initial value for the characeristic:
  servoCharacteristic1.writeValue(0);
  servoCharacteristic2.writeValue(0);

  // start advertising
  BLE.advertise();
}

bool verifyCheckSum(unsigned char data[], unsigned char len) {
  unsigned char checksum = 0;
  for (int k = 0; k < len - 1; k++) {
    checksum += data[k];
  }
  return (checksum == data[len - 1]);
}

void loop() {
  // listen for Bluetooth® Low Energy peripherals to connect:
  BLEDevice central = BLE.central();

  // if a central is connected to peripheral:
  if (central) {
    // print the central's MAC address:
    // while the central is still connected to peripheral:
    while (central.connected()) {
      // if the remote device wrote to the characteristic,
      // use the value to control the LED:

      if (Serial1.available() >= 32) {
    // Чтение данных из порта
    for (int i = 0; i < 32; i++) {
      TOF_data[i] = Serial1.read();
    }
    for (int j = 0; j < 16; j++) {
      if (TOF_data[j] == TOF_header[0] && TOF_data[j + 1] == TOF_header[1] && TOF_data[j + 2] == TOF_header[2] && verifyCheckSum(&TOF_data[j], TOF_length)) {
        if (((TOF_data[j + 12]) | (TOF_data[j + 13] << 8)) != 0) 
         {
          TOF_distance = (TOF_data[j + 8]) | (TOF_data[j + 9] << 8) | (TOF_data[j + 10] << 16);
          // Find closest match in measuredDistances
          int closestIndex = 0;
          float smallestDifference = abs(measuredDistances[0] - TOF_distance);
          for (int k = 1; k < sizeof(measuredDistances) / sizeof(measuredDistances[0]); k++) {
            float diff = abs(measuredDistances[k] - TOF_distance);
            if (diff < smallestDifference) {
              smallestDifference = diff;
              closestIndex = k;
            }
          }
          // Output corresponding real distance
            TOF_signal = (TOF_data[j + 12]) | (TOF_data[j + 13] << 8);
            if (servoCharacteristic1.written()&&servoCharacteristic2.written()) {
            servo_pos1=servoCharacteristic1.value();
            servo_pos2=servoCharacteristic2.value();
            /*
            Serial.println(servo_pos1);
            Serial.println(servo_pos2);
            Serial.print(TOF_distance, DEC);
            */
           
            Serial.print(servo_pos1);
            Serial.print(",");
            Serial.print(servo_pos2);
            Serial.print(",");
            Serial.print(realDistances[closestIndex]);
            Serial.print(",");
            Serial.print(micros());
            Serial.println(",");
            }

           // fprintf(test, "mks %d, real distence %f, TOF signal %d, servo 1 %d, servo 2 %d \n", micros(), realDistances[closestIndex], TOF_signal, servo_pos1, servo_pos2);
        }
        break;
      }
      
    }
  }
    /*
      if (servoCharacteristic1.written()&&servoCharacteristic2.written()) {
        servo_pos1=servoCharacteristic1.value();
        servo_pos2=servoCharacteristic2.value();
        Serial.println("characteristic received ");
        //Serial.println("");
        Serial.println(servo_pos1);
        Serial.println(servo_pos2);
        Serial.println("");
      }
      */
    }
    //fclose(test);
    Serial.print(F("Disconnected from central: "));
    Serial.println(central.address());
    
  }
}